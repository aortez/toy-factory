/*
 * Copyright (c) 2026 Toy Factory contributors
 *
 * SPDX-License-Identifier: Apache-2.0
 */

#include <zephyr/dt-bindings/dma/rpi-pico-dma-rp2040.h>

&dma {
	status = "okay";
};

&spi0 {
	dmas = <&dma 0 RPI_PICO_DMA_SLOT_SPI0_TX 0>,
	       <&dma 1 RPI_PICO_DMA_SLOT_SPI0_RX 0>;
	dma-names = "tx", "rx";
};
