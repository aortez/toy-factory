## boards/pimoroni/picosystem/Kconfig.picosystem
```kconfig
# SPDX-License-Identifier: Apache-2.0

config BOARD_PICOSYSTEM
	select SOC_RP2040
```

## boards/pimoroni/picosystem/board.yml
```yaml
board:
  name: picosystem
  full_name: PicoSystem (PIM559)
  vendor: pimoroni
  socs:
    - name: rp2040
```
